## software/examples/sound-selftest/firmware/sdkconfig.defaults
```kconfig
# ── Target ──────────────────────────────────────────────────────────────────
CONFIG_IDF_TARGET="esp32s3"

# ── Arduino-as-component: auto-run setup()/loop(); Serial on UART0 (CH340C) ──
CONFIG_AUTOSTART_ARDUINO=y
CONFIG_FREERTOS_HZ=1000

# ── 8 MB flash, QIO mode ──────────────────────────────────────────────────────
CONFIG_ESPTOOLPY_FLASHSIZE_8MB=y
CONFIG_ESPTOOLPY_FLASHMODE_QIO=y

# ── Custom 8 MB partition table (matches Arduino default_8MB.csv) ─────────────
CONFIG_PARTITION_TABLE_CUSTOM=y
CONFIG_PARTITION_TABLE_CUSTOM_FILENAME="partitions.csv"
```

## software/mods/onion-os/sdkconfig.defaults
```kconfig
# Target
CONFIG_IDF_TARGET="esp32s3"

# Arduino-as-component: auto-run setup()/loop(); Serial on UART0 (CH340C)
CONFIG_AUTOSTART_ARDUINO=y
CONFIG_FREERTOS_HZ=1000

# 8 MB flash, QIO mode
CONFIG_ESPTOOLPY_FLASHSIZE_8MB=y
CONFIG_ESPTOOLPY_FLASHMODE_QIO=y

# 8 MB Octal (OPI) PSRAM @ 80 MHz (ESP32-S3-WROOM-1-N8R8)
CONFIG_SPIRAM=y
CONFIG_SPIRAM_MODE_OCT=y
CONFIG_SPIRAM_SPEED_80M=y

# Custom 8 MB partition table
CONFIG_PARTITION_TABLE_CUSTOM=y
CONFIG_PARTITION_TABLE_CUSTOM_FILENAME="partitions.csv"

# ATECC608B secure element on the shared badge I2C bus.
CONFIG_ATECC608A_TCUSTOM=y
# CONFIG_ATECC608A_TNG is not set
# CONFIG_ATECC608A_TFLEX is not set
CONFIG_ATCA_I2C_SDA_PIN=10
CONFIG_ATCA_I2C_SCL_PIN=9
CONFIG_ATCA_I2C_ADDRESS=0xC0
CONFIG_ATCA_I2C_BAUD_RATE=100000
```
